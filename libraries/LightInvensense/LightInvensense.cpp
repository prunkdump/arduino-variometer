/* LightInvensense -- Light and optimized Invensense IMU driver
 *
 * Copyright 2016-2019 Baptiste PELLEGRIN
 * 
 * This file is part of GNUVario.
 *
 * GNUVario is free software: you can redistribute it and/or modify
 * it under the terms of the GNU General Public License as published by
 * the Free Software Foundation, either version 3 of the License, or
 * (at your option) any later version.
 *
 * GNUVario is distributed in the hope that it will be useful,
 * but WITHOUT ANY WARRANTY; without even the implied warranty of
 * MERCHANTABILITY or FITNESS FOR A PARTICULAR PURPOSE.  See the
 * GNU General Public License for more details.
 *
 * You should have received a copy of the GNU General Public License
 * along with this program.  If not, see <https://www.gnu.org/licenses/>.
 */

#include <LightInvensense.h>

#include <Arduino.h>

#ifdef LIGHT_INVENSENSE_BUILD
#include <inv_mpu.h>
#include <inv_mpu_dmp_motion_driver.h>
#endif

#include <InvenSense_defines.h>
#include <IntTW.h>

#define MAX_INIT_RESET_RETRY 20

/* original firmware parameters */
#define INV_DMP_CODE_SIZE (3062)
#define INV_DMP_START_ADDRESS (0x0400)
#define DMP_CHUNK_SIZE 16

/* how display result */
#define DMP_CODE_LINE_SIZE 16


#define DMP_FEATURE_SEND_ANY_GYRO   (DMP_FEATURE_SEND_RAW_GYRO | \
                                     DMP_FEATURE_SEND_CAL_GYRO)
#define INT_SRC_TAP             (0x01)
#define INT_SRC_ANDROID_ORIENT  (0x08)

/*----------------------------------*/
/*                                  */
/*      DMP Firmware Builder        */
/*                                  */
/*----------------------------------*/

/**************************************/
/* current custom compressed firmware */
/**************************************/

/*----------------PASTE HERE -------------------*/
const uint8_t compressedFirmware[] PROGMEM = {
   0x00, 0x01, 0x70, 0x00, 0x03, 0x24, 0x00, 0x02, 0x02, 0x00, 0x00, 0x03, 0x00, 0x02, 0x65, 0x00,
   0x00, 0x54, 0xFF, 0xEF, 0x00, 0x01, 0xFA, 0x80, 0x00, 0x00, 0x0B, 0x12, 0x82, 0x00, 0x00, 0x01,
   0x03, 0x0C, 0x30, 0xC3, 0x0E, 0x8C, 0x8C, 0xE9, 0x14, 0xD5, 0x40, 0x02, 0x13, 0x71, 0x0F, 0x8E,
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   0x96, 0x88, 0xA6, 0xD9, 0x00, 0x00, 0xD8, 0xF1, 0xFF };
#define COMPRESSED_DMP_CODE_SIZE 2665
#define COMPRESSED_DMP_LPF_CFG (0x2)
#define COMPRESSED_DMP_RATE_DIV_CFG (0x4)
#define COMPRESSED_DMP_PAQUET_RAW_ACCEL
#define COMPRESSED_DMP_PAQUET_QUAT
#define COMPRESSED_DMP_PAQUET_GESTURE
#define COMPRESSED_DMP_PAQUET_TAP
#define COMPRESSED_DMP_PAQUET_LENGTH 26
/*----------------END HERE -------------------*/

static uint8_t dmpChunk[DMP_CHUNK_SIZE];

#ifdef LIGHT_INVENSENSE_BUILD
/************************/
/* firmware compression */
/************************/

  
/* print a c++ formated buffer */ 
static unsigned hexValueCount = 0;

void print_hex_value(uint8_t value) {

  /* separator */ 
  if(hexValueCount % DMP_CODE_LINE_SIZE != 0) {
    Serial.print(", ");
  }
  
  /* print value */
  Serial.print("0x");
  if( value < 0x10 ) {
    Serial.print("0");
  }
  Serial.print(value, HEX);
  hexValueCount++;
  
  /* new line ? */
  if( hexValueCount % DMP_CODE_LINE_SIZE == 0 ) {
    Serial.print(",\n   ");
  }
}

/* read dmp memory byte per byte */
static uint16_t memPos = (uint16_t)(-1);
static uint16_t chunkPos = 0;

uint8_t readDmpMemory(void) {

  memPos++;

  /* need to load a new chunk ? */
  if( memPos % DMP_CHUNK_SIZE == 0) {
    mpu_read_mem(memPos, DMP_CHUNK_SIZE, dmpChunk);
    chunkPos = 0;
  }

  /* get the code char */
  uint8_t c = dmpChunk[chunkPos];
  chunkPos++;
  
  return c;
}


/* compress dmp memory */
int createCompressedFirmware(void) {
  
  /*****************/
  /* init settings */
  /*****************/
  
  /* setting imu */
  if( mpu_init(NULL) < 0 )
    return -1;
  
  if( mpu_set_sensors(INV_XYZ_GYRO|INV_XYZ_ACCEL) < 0 )
    return -1;
  
  /* set fsrs */
  uint16_t fsr;
  
  switch( LIGHT_INVENSENSE_GYRO_FSR ) {
  case  INV_FSR_250DPS: fsr = 250; break;
  case  INV_FSR_500DPS: fsr = 500; break;
  case  INV_FSR_1000DPS: fsr = 1000; break;
  case  INV_FSR_2000DPS: fsr = 2000; break;
  default: fsr = 0;
  }
  if( mpu_set_gyro_fsr(fsr) < 0 )
    return -1;

  switch( LIGHT_INVENSENSE_ACCEL_FSR ) {
  case INV_FSR_2G: fsr = 2; break;
  case INV_FSR_4G: fsr = 4; break;
  case INV_FSR_8G: fsr = 8; break;
  case INV_FSR_16G: fsr = 16; break;
  default: fsr = 0;
  }
  if( mpu_set_accel_fsr(fsr) < 0 )
    return -1;

  /* setting dmp */
  if( dmp_load_motion_driver_firmware() < 0 )
    return -1;
  if( dmp_set_fifo_rate(LIGHT_INVENSENSE_DMP_SAMPLE_RATE) < 0 )
    return -1;
  if( dmp_enable_feature(LIGHT_INVENSENSE_DMP_FEATURES) < 0 )
    return -1;

  /* setting tap if enabled */
  if( LIGHT_INVENSENSE_DMP_FEATURES & DMP_FEATURE_TAP ) {
    if(dmp_set_tap_axes(LIGHT_INVENSENSE_TAP_AXES) < 0)
      return -1;
    if(dmp_set_tap_thresh(LIGHT_INVENSENSE_TAP_AXES, LIGHT_INVENSENSE_TAP_THRESH) < 0)
      return -1;
    if(dmp_set_tap_count(LIGHT_INVENSENSE_TAP_COUNT) < 0)
      return -1;
    if(dmp_set_tap_time(LIGHT_INVENSENSE_TAP_TIME) < 0)
      return -1;
    if( dmp_set_tap_time_multi(LIGHT_INVENSENSE_TAP_TIME_MULTI) < 0)
      return -1;
  }
  
  /*********************/
  /* Compress firmware */
  /*********************/
  
  unsigned readPos = 0;
  bool zeroFound = false;
  unsigned zeroCount;

  Serial.print("const uint8_t compressedFirmware[] PROGMEM = {\n   ");
  
  /* read all the code */
  while( readPos < INV_DMP_CODE_SIZE ) {

    /* get current char */
    uint8_t ic = readDmpMemory();

    /* not counting zero */
    if( ! zeroFound ) {

      /* start counting zero ? */
      if( ic == 0x00 ) {
	zeroFound = true;
	zeroCount = 0;
      }

      print_hex_value(ic);
    }

    /* counting zero */
    else {

      /* zero again ? */
      if( ic == 0x00 ) {
	zeroCount++;
      }

      /* else print zero count */
      else {
	print_hex_value(zeroCount);
	print_hex_value(ic);
	zeroFound = false;
      }
    }

    /* next */
    readPos++;
  }

  Serial.print(" };\n");
  Serial.print("#define COMPRESSED_DMP_CODE_SIZE ");
  Serial.print(hexValueCount, DEC);
  Serial.print("\n");

  /******************/
  /* get dmp config */
  /******************/
  uint8_t data;

  /* start dmp */
  mpu_set_dmp_state(1);

  /* read LPF config (depend on sample rate) */
  intTW.readBytes(INV_HW_ADDR, INV_REG_LPF, 1, &data);
  Serial.print("#define COMPRESSED_DMP_LPF_CFG (0x");
  Serial.print(data, HEX);
  Serial.print(")\n");

  /* read sample rate (depend on DMP firmware) */
  intTW.readBytes(INV_HW_ADDR, INV_REG_RATE_DIV, 1, &data);
  Serial.print("#define COMPRESSED_DMP_RATE_DIV_CFG (0x");
  Serial.print(data, HEX);
  Serial.print(")\n");

  /******************/
  /* paquet length  */
  /******************/
  unsigned packet_length = 0;
  if (LIGHT_INVENSENSE_DMP_FEATURES & DMP_FEATURE_SEND_RAW_ACCEL) {
    Serial.print("#define COMPRESSED_DMP_PAQUET_RAW_ACCEL\n");
    packet_length += 6;
  }
  
  if (LIGHT_INVENSENSE_DMP_FEATURES & DMP_FEATURE_SEND_ANY_GYRO) {
    Serial.print("#define COMPRESSED_DMP_PAQUET_GYRO\n");
    packet_length += 6;
  }
      
  if (LIGHT_INVENSENSE_DMP_FEATURES & (DMP_FEATURE_LP_QUAT | DMP_FEATURE_6X_LP_QUAT)) {
    Serial.print("#define COMPRESSED_DMP_PAQUET_QUAT\n");
    packet_length += 16;
  }
  
  if (LIGHT_INVENSENSE_DMP_FEATURES & (DMP_FEATURE_TAP | DMP_FEATURE_ANDROID_ORIENT)) {
    Serial.print("#define COMPRESSED_DMP_PAQUET_GESTURE\n");
    packet_length += 4;
    if(LIGHT_INVENSENSE_DMP_FEATURES & DMP_FEATURE_TAP) {
      Serial.print("#define COMPRESSED_DMP_PAQUET_TAP\n");
    }
    if(LIGHT_INVENSENSE_DMP_FEATURES & DMP_FEATURE_ANDROID_ORIENT) {
      Serial.print("#define COMPRESSED_DMP_PAQUET_ANDROID_ORIENT\n");
    }
  }

  Serial.print("#define COMPRESSED_DMP_PAQUET_LENGTH ");
  Serial.print(packet_length, DEC);
  Serial.print("\n");

  return 0;
  
}

#endif //LIGHT_INVENSENSE_BUILD

/**************************/
/* Firmware decompression */
/**************************/

static unsigned decReadPos = 0;
static unsigned decZeroCount = 0;
 
/* return 1 byte */
uint8_t decodeCompressedFirmware(void) {

  /* already finish ? */
  if( decReadPos >= COMPRESSED_DMP_CODE_SIZE) {
    return 0x00;  //return 0x00 even if zeroCount != 0
  }

  /********************/
  /* output next char */
  /********************/
  
  /* output remaining zeros */
  if( decZeroCount != 0 ) {
    decZeroCount--;
    return 0x00;
  }

  /* else decompress */
  uint8_t c; 
  c = pgm_read_byte(compressedFirmware + decReadPos);
  decReadPos++;

  /* check for zero */
  if( c != 0x00 ) {
    return c;
  } else {
    decZeroCount = pgm_read_byte(compressedFirmware + decReadPos);
    decReadPos++;
  }
  
  return 0x00;
}
  
int fastMPUWriteMem(uint16_t memAddr, uint16_t length, const uint8_t *data);

int loadCompressedFirmware(void) {
  
  uint16_t writePos = 0;
  while( writePos < INV_DMP_CODE_SIZE ) {

    /* decompress chunk */
    for(int i = 0; i<DMP_CHUNK_SIZE; i++) {
      dmpChunk[i] = decodeCompressedFirmware();
    }

    /* write chunk */
    if( fastMPUWriteMem(writePos, DMP_CHUNK_SIZE, dmpChunk) < 0 ) 
      return -1;

    /* next */
    writePos += DMP_CHUNK_SIZE;
  }

  return 0;
}
  


/*----------------------------------*/
/*                                  */
/*      Light MPU library           */
/*                                  */
/*----------------------------------*/

int fastMPUWriteMem(uint16_t memAddr, uint16_t length, const uint8_t *data) {

  uint8_t com[2];

  /* set bank */
  com[0] = (uint8_t)(memAddr >> 8);
  com[1] = (uint8_t)(memAddr & 0xFF);
  intTW.writeBytes(INV_HW_ADDR, INV_REG_BANK_SEL, 2, com);

  /* write data */
  intTW.writeBytes(INV_HW_ADDR, INV_REG_MEM_R_W, length, data);
  
  return 0;
}


int fastMPUReadMem(uint16_t memAddr, uint16_t length, uint8_t *data) {

  uint8_t com[2];

  /* set bank */
  com[0] = (uint8_t)(memAddr >> 8);
  com[1] = (uint8_t)(memAddr & 0xFF);
  intTW.writeBytes(INV_HW_ADDR, INV_REG_BANK_SEL, 2, com);

  /* write data */
  intTW.readBytes(INV_HW_ADDR, INV_REG_MEM_R_W, length, data);
  
  return 0;
}

void disableDMP(void) {
  
  uint8_t data;

  /* clear */
  data = 0;
  intTW.writeBytes(INV_HW_ADDR, INV_REG_INT_ENABLE, 1, &data);
  intTW.writeBytes(INV_HW_ADDR, INV_REG_FIFO_EN, 1, &data);
  intTW.writeBytes(INV_HW_ADDR, INV_REG_USER_CTRL, 1, &data);
  
  /* reset DMP FIFO */
  data = BIT_FIFO_RST | BIT_DMP_RST;
  intTW.writeBytes(INV_HW_ADDR, INV_REG_USER_CTRL, 1, &data);
  delay(50);
}

void enableDMP(void) {

  uint8_t data;

  /* enable DMP FIFO */
  data = BIT_DMP_EN |
#ifdef AK89xx_SECONDARY
    BIT_AUX_IF_EN |
#endif
    BIT_FIFO_EN;
  intTW.writeBytes(INV_HW_ADDR, INV_REG_USER_CTRL, 1, &data);
  
  /* reset STD FIFO */
  data = 0;
  intTW.writeBytes(INV_HW_ADDR, INV_REG_INT_ENABLE, 1, &data);
  intTW.writeBytes(INV_HW_ADDR, INV_REG_FIFO_EN, 1, &data);
}

int fastFIFOReset(void) {

  disableDMP();
  enableDMP();

  return 0;
}


#ifdef AK89xx_SECONDARY
static uint8_t magSensAdj[3];

void readMagSensAdj(void) {

  /* get access */
  disableDMP();

  /************/
  /* read adj */
  /************/
  uint8_t tmp[3];

  /* bypass */
  tmp[0] = BIT_BYPASS_EN;
  intTW.writeBytes(INV_HW_ADDR, INV_REG_INT_PIN_CFG, 1, tmp); 

  /* get fuse access */
  tmp[0] = AKM_POWER_DOWN;
  intTW.writeBytes(LIGHT_INVENSENSE_COMPASS_ADDR, AKM_REG_CNTL, 1, tmp);
  delay(1);

  tmp[0] = AKM_FUSE_ROM_ACCESS;
  intTW.writeBytes(LIGHT_INVENSENSE_COMPASS_ADDR, AKM_REG_CNTL, 1, tmp);
  delay(1);
  
  /* read values */
  intTW.readBytes(LIGHT_INVENSENSE_COMPASS_ADDR, AKM_REG_ASAX, 3, magSensAdj);
  
  /* stop bypass */
  tmp[0] = 0;
  intTW.writeBytes(INV_HW_ADDR, INV_REG_INT_PIN_CFG, 1, tmp);   

  /* enable DMP */
  enableDMP();
}
#endif




void saveInt32(int32_t value, uint8_t* data) {

  for( int i = 3; i>=0; i-- ) {
      data[i] = value & 0xff;
      value >>= 8;
  }
}
  

/****************************************************************/
/* Gyro bias in DMP :                                           */
/*                                                              */
/*  mpuGyroBias = ( (gyroBias in q16) * INV_GYRO_SF ) >> 30     */
/****************************************************************/
void computeGyroBias(int32_t bias, uint8_t* data) {

  int64_t qbias = (int64_t)bias * INV_GYRO_SF;
  qbias >> 30;

  saveInt32( (int32_t)qbias, data);
}

int fastMPUSetGyroBias(const uint8_t* bias) {

  /* write to DMP memory */
  fastMPUWriteMem(INV_D_EXT_GYRO_BIAS, 12, bias);

  return 0;
}

int fastMPUReadGyroBias(uint8_t* bias) {

  /* read from DMP memory */
  fastMPUReadMem(INV_D_EXT_GYRO_BIAS, 12, bias);

  return 0;
}

int fastMPUSetGyroBias(const int16_t* bias) {

  uint8_t data[12];

  /* compute gyro bias */
  uint8_t* datap = data;
  for(int i = 0; i<3; i++) {
    int32_t qbias = (int32_t)bias[i] << 16;
    computeGyroBias(qbias, datap);
    datap += 4;
  }

  /* set on DMP */
  fastMPUSetGyroBias(data);
}


int fastMPUSetGyroBiasQ16(const int32_t* bias) {

  uint8_t data[12];

  /* compute gyro bias */
  uint8_t* datap = data;
  for(int i = 0; i<3; i++) {
    computeGyroBias(bias[i], datap);
    datap += 4;
  }

  /* set on DMP */
  fastMPUSetGyroBias(data);
}


/******************************/
/* Accel bias on DMP :        */
/*                            */
/* Stored on q15 format       */
/******************************/
int fastMPUSetAccelBias(const uint8_t* bias) {

  /* write to DMP memory */
  fastMPUWriteMem(INV_D_ACCEL_BIAS, 12, bias);

  return 0;
}

int fastMPUReadAccelBias(uint8_t* bias) {

  /* read from DMP memory */
  fastMPUReadMem(INV_D_ACCEL_BIAS, 12, bias);

  return 0;
}


/* accel bias must be saved in q15 format */
int fastMPUSetAccelBias(const int16_t* bias) {

  uint8_t data[12];

  /* convert to q15 */
  uint8_t* datap = data;
  for(int i = 0; i<3; i++) {
    int32_t qbias = (int32_t)bias[i] << 15;
    saveInt32(qbias, datap);
    datap += 4;
  }

  /* save */  
  fastMPUSetAccelBias(data);

  return 0;
}


/* directly in q15 */
int fastMPUSetAccelBiasQ15(const int32_t* bias) {

  uint8_t data[12];
  
  uint8_t* datap = data;
  for(int i = 0; i<3; i++) {
    saveInt32(bias[i], datap);
    datap += 4;
  }

  /* save */  
  fastMPUSetAccelBias(data);

  return 0;
}


void fastMPUStart(void);

int fastMPUInit(bool startMPU) {

  uint8_t data[2];

  /*****************/
  /* Reset device  */
  /*****************/
  bool resettingError = true;
  unsigned resetCountStep = 0;

  while( resettingError && resetCountStep < MAX_INIT_RESET_RETRY ) {

    resettingError = false;

    /* send reset command */
    data[0] = BIT_RESET;
    if( !intTW.writeBytes(INV_HW_ADDR, INV_REG_PWR_MGMT_1, 1, data) ) {
      resettingError = true;
    }      
    delay(100);

    /* read reset result */
    if( !resettingError ) {
      if( intTW.readBytes(INV_HW_ADDR, INV_REG_PWR_MGMT_1, 1, data) != 1 )
	resettingError = true;
    }

    /* check reset result */
    if( !resettingError ) {
      if( data[0] & BIT_RESET )
	resettingError = true;
    }

    /* next try if needed */
    resetCountStep++;
  }

  /* check reset */
  if( resettingError ) {
    return -1;
  }

  /********************/
  /* start the device */
  /********************/
  
  /* Wake up chip. */
  data[0] = 0x00;
  intTW.writeBytes(INV_HW_ADDR, INV_REG_PWR_MGMT_1, 1, data);

#ifdef MPU6500
  /* MPU6500 shares 4kB of memory between the DMP and the FIFO. Since the
   * first 3kB are needed by the DMP, we'll use the last 1kB for the FIFO.
   */
  data[0] = BIT_FIFO_SIZE_1024;
  intTW.writeBytes(INV_HW_ADDR, INV_REG_ACCEL_CFG2, 1, data);
#endif

  /****************/
  /* set settings */
  /****************/

  /* set gyro fsr */
  data[0] = LIGHT_INVENSENSE_GYRO_FSR << 3;
  intTW.writeBytes(INV_HW_ADDR, INV_REG_GYRO_CFG, 1, data);

  /* set accel fsr */
  data[0] = LIGHT_INVENSENSE_ACCEL_FSR << 3;
  intTW.writeBytes(INV_HW_ADDR, INV_REG_ACCEL_CFG, 1, data);

  /* set low pass filter */
  data[0] = COMPRESSED_DMP_LPF_CFG;
  intTW.writeBytes(INV_HW_ADDR, INV_REG_LPF, 1, data);

#ifdef MPU6500 //MPU6500 accel/gyro dlpf separately
  data[0] = BIT_FIFO_SIZE_1024 | data[0];
  intTW.writeBytes(INV_HW_ADDR, INV_REG_ACCEL_CFG2, 1, data);
#endif

  /********************/
  /* power on sensors */
  /********************/

  /* power on gyro and accel */
  data[0] = 0; //all power on
  intTW.writeBytes(INV_HW_ADDR, INV_REG_PWR_MGMT_2, 1, data);
  delay(50);
  
  /****************/
  /* set firmware */
  /****************/

  /* load */
  loadCompressedFirmware();

  /* set start address */
  data[0] = INV_DMP_START_ADDRESS >> 8;
  data[1] = INV_DMP_START_ADDRESS & 0xFF;
  intTW.writeBytes(INV_HW_ADDR, INV_REG_PRGM_START_H, 2, data);

#ifdef AK89xx_SECONDARY
  /*****************/
  /* setup compass */
  /*****************/

  /* slave 0 : read mag value */
  data[0] = BIT_I2C_READ | LIGHT_INVENSENSE_COMPASS_ADDR;
  intTW.writeBytes(INV_HW_ADDR, INV_REG_S0_ADDR, 1, data);
  data[0] = AKM_REG_ST1;
  intTW.writeBytes(INV_HW_ADDR, INV_REG_S0_REG, 1, data);
  data[0] = BIT_SLAVE_EN | 8;
  intTW.writeBytes(INV_HW_ADDR, INV_REG_S0_CTRL, 1, data);
  

  /* slave 1 : launch single measurement */
  /*
  data[0] = LIGHT_INVENSENSE_COMPASS_ADDR;
  intTW.writeBytes(INV_HW_ADDR, INV_REG_S1_ADDR, 1, data);
  data[0] = AKM_REG_CNTL;
  intTW.writeBytes(INV_HW_ADDR, INV_REG_S1_REG, 1, data);
  data[0] = BIT_SLAVE_EN | 1;
  intTW.writeBytes(INV_HW_ADDR, INV_REG_S1_CTRL, 1, data);
  data[0] = AKM_SINGLE_MEASUREMENT;
  intTW.writeBytes(INV_HW_ADDR, INV_REG_S1_DO, 1, data);
  */

  /* slave 4 :  launch single measurement */
  data[0] = LIGHT_INVENSENSE_COMPASS_ADDR;
  intTW.writeBytes(INV_HW_ADDR, INV_REG_S4_ADDR, 1, data);
  data[0] = AKM_REG_CNTL;
  intTW.writeBytes(INV_HW_ADDR, INV_REG_S4_REG, 1, data);
  //TODO check rate 
  data[0] = BIT_SLAVE_EN | ((1000/(1+COMPRESSED_DMP_RATE_DIV_CFG)) / LIGHT_INVENSENSE_COMPASS_SAMPLE_RATE - 1);
  intTW.writeBytes(INV_HW_ADDR, INV_REG_S4_CTRL, 1, data);
  data[0] = AKM_SINGLE_MEASUREMENT;
  intTW.writeBytes(INV_HW_ADDR, INV_REG_S4_DO, 1, data);

  /* active slaves and set sample rate */
  //data[0] = 0x03;
  data[0] = 0x11;
  intTW.writeBytes(INV_HW_ADDR, INV_REG_I2C_DELAY_CTRL, 1, data);
#ifdef MPU9150
  data[0] = BIT_I2C_MST_VDDIO;
  intTW.writeBytes(INV_HW_ADDR, INV_REG_YG_OFFS_TC, 1, data);
#endif //MPU9150
  /*
  data[0] = (1000/(1+COMPRESSED_DMP_RATE_DIV_CFG)) / LIGHT_INVENSENSE_COMPASS_SAMPLE_RATE - 1;
  intTW.writeBytes(INV_HW_ADDR, INV_REG_S4_CTRL, 1, data);
  */
#endif  
  
  /**************/
  /* enable dmp */
  /**************/

  /* set sample rate */
  data[0] = COMPRESSED_DMP_RATE_DIV_CFG; 
  intTW.writeBytes(INV_HW_ADDR, INV_REG_RATE_DIV, 1, data);

  /**************/
  /* reset fifo */
  /**************/
  if( startMPU ) {
    fastMPUStart();
  }
  
  return 0;
}


void fastMPUStart(void) {

#ifdef AK89xx_SECONDARY
  readMagSensAdj(); //also reset FIFO
#else
  fastFIFOReset();
#endif
}


/* tap call back */
void (*tapCallBack)(uint8_t, uint8_t) = NULL;

void fastMPUSetTapCallback(void (*callback)(uint8_t, uint8_t)) {

  tapCallBack = callback;
}

void fastMPUCheckTap(uint8_t tap) {
  
#ifdef COMPRESSED_DMP_PAQUET_GESTURE
#ifdef COMPRESSED_DMP_PAQUET_TAP
  if( tap ) {
    uint8_t direction = tap >> 3;
    uint8_t count = (tap % 8) + 1;
    tapCallBack(direction, count);
  }  
#endif //COMPRESSED_DMP_PAQUET_TAP
#endif //COMPRESSED_DMP_PAQUET_GESTURE
}


/* fifo */
uint8_t fastMPUGetFIFOPaquetLength(void) {

  return COMPRESSED_DMP_PAQUET_LENGTH;
}

int8_t fastMPUHaveFIFOPaquet(uint16_t fifoCount) {
  
  if( fifoCount < COMPRESSED_DMP_PAQUET_LENGTH )
    return 0;

  /* if fifo is at least 50%, check overflow */
  if( fifoCount > (INV_HW_MAX_FIFO >> 1) ) {
    return -1;
  }

  return 1;
}


void fastMPUParseFIFO(uint8_t* dmpPaquet, int16_t *gyro, int16_t *accel, int32_t *quat, uint8_t& tap) {
  
  /********************/
  /* parse DMP paquet */
  /********************/
  uint8_t* dmpPaquetP = dmpPaquet;
  
#ifdef COMPRESSED_DMP_PAQUET_QUAT
  for(int i = 0; i<4; i++ ) {
    quat[i] = 0;
    for(int j = 0; j<4; j++) {
      quat[i] <<= 8;
      quat[i] += (int32_t)(*dmpPaquetP);
      dmpPaquetP++;
    }
  }
  
  /* 
  quat[0] = ((int32_t)fifo_data[0] << 24) | ((int32_t)fifo_data[1] << 16) | ((int32_t)fifo_data[2] << 8) | fifo_data[3];
  quat[1] = ((int32_t)fifo_data[4] << 24) | ((int32_t)fifo_data[5] << 16) | ((int32_t)fifo_data[6] << 8) | fifo_data[7];
  quat[2] = ((int32_t)fifo_data[8] << 24) | ((int32_t)fifo_data[9] << 16) | ((int32_t)fifo_data[10] << 8) | fifo_data[11];
  quat[3] = ((int32_t)fifo_data[12] << 24) | ((int32_t)fifo_data[13] << 16) | ((int32_t)fifo_data[14] << 8) | fifo_data[15];
  */
#endif

#ifdef COMPRESSED_DMP_PAQUET_RAW_ACCEL
  for(int i = 0; i<3; i++ ) {
    accel[i] = ((int16_t)(dmpPaquetP[0]) << 8) | (int16_t)(dmpPaquetP[1]);
    dmpPaquetP += 2;
  }

  /*
  accel[0] = ((int16_t)fifo_data[ii+0] << 8) | fifo_data[ii+1];
  accel[1] = ((int16_t)fifo_data[ii+2] << 8) | fifo_data[ii+3];
  accel[2] = ((int16_t)fifo_data[ii+4] << 8) | fifo_data[ii+5];  
  */
#endif

#ifdef COMPRESSED_DMP_PAQUET_GYRO
  for(int i = 0; i<3; i++ ) {
    gyro[i] = ((int16_t)(dmpPaquetP[0]) << 8) | (int16_t)(dmpPaquetP[1]);
    dmpPaquetP += 2;
  }

  /*
  gyro[0] = ((int16_t)fifo_data[ii+0] << 8) | fifo_data[ii+1];
  gyro[1] = ((int16_t)fifo_data[ii+2] << 8) | fifo_data[ii+3];
  gyro[2] = ((int16_t)fifo_data[ii+4] << 8) | fifo_data[ii+5];
  */
#endif


#ifdef COMPRESSED_DMP_PAQUET_GESTURE
#ifdef COMPRESSED_DMP_PAQUET_TAP
  if( (dmpPaquetP[1] & INT_SRC_TAP) && tapCallBack ) {
    tap = 0x3F & dmpPaquetP[3];
  } else {
    tap = 0;
  }
#endif //COMPRESSED_DMP_PAQUET_TAP
#else
  tap = 0;
#endif //COMPRESSED_DMP_PAQUET_GESTURE 
}


int fastMPUReadFIFO(int16_t *gyro, int16_t *accel, int32_t *quat) {

  uint8_t data[2];

  /*******************/
  /* read one paquet */
  /*******************/
  uint8_t dmpPaquet[COMPRESSED_DMP_PAQUET_LENGTH];
  
  /* read fifo count for one paquet */
  uint16_t fifoCount;

  intTW.readBytes(INV_HW_ADDR, INV_REG_FIFO_COUNT_H, 2, data);
  fifoCount = (data[0] << 8) | data[1];

  int8_t fifoState = fastMPUHaveFIFOPaquet(fifoCount);

  if( fifoState == 0 )
    return -1;

  /* if fifo is at least 50%, check overflow */
  if( fifoState < 0 ) {
    intTW.readBytes(INV_HW_ADDR, INV_REG_INT_STATUS, 1, data);
    if( data[0] & BIT_FIFO_OVERFLOW ) {
      fastFIFOReset();
      return -1;
    }
  }

  /* read paquet */
  intTW.readBytes(INV_HW_ADDR, INV_REG_FIFO_R_W, COMPRESSED_DMP_PAQUET_LENGTH, dmpPaquet);

  /* parse paquet */
  uint8_t tap;
  fastMPUParseFIFO(dmpPaquet, gyro, accel, quat, tap);

  /* check tap */
#ifdef COMPRESSED_DMP_PAQUET_GESTURE
#ifdef COMPRESSED_DMP_PAQUET_TAP
  fastMPUCheckTap(tap); 
#endif //COMPRESSED_DMP_PAQUET_TAP
#endif //COMPRESSED_DMP_PAQUET_GESTURE

  return 0;
}

#ifdef AK89xx_SECONDARY
bool fastMPUMagReady(void) {

  uint8_t data;
  intTW.readBytes(INV_HW_ADDR, INV_REG_I2C_MST_STATUS, 1, &data);
  return (data & 0x40); //I2C_SLV4_DONE
}

int fastMPUParseRawMag(uint8_t* magData, int16_t* mag) {
  
  /* check for errors */
#if defined AK8975_SECONDARY
  /* AK8975 doesn't have the overrun error bit. */
  if (!(magData[0] & AKM_DATA_READY))
    return -2;
  if ((magData[7] & AKM_OVERFLOW) || (magData[7] & AKM_DATA_ERROR))
    return -3;
#elif defined AK8963_SECONDARY
  /* AK8963 doesn't have the data read error bit. */
  if (!(magData[0] & AKM_DATA_READY) || (magData[0] & AKM_DATA_OVERRUN))
    return -2;
  if (magData[7] & AKM_OVERFLOW)
    return -3;
#endif

  /* return */
  /* remap as accelerometer */
  /* mag x -> y */
  /* mag y -> x */
  /* mag z -> -z */
  mag[1] = (magData[2] << 8) | magData[1];
  mag[0] = (magData[4] << 8) | magData[3];
  mag[2] = -((int16_t)(magData[6] << 8) | magData[5]);

  return 0;
}
  

int fastMPUReadRawMag(int16_t* mag) {

  /* read raw data */
  uint8_t magData[8];
  intTW.readBytes(INV_HW_ADDR, INV_REG_RAW_COMPASS, 8, magData);

  /* parse data */
  return fastMPUParseRawMag(magData, mag);
}


uint8_t* fastMPUGetMagSensAdj(void) {

  return magSensAdj;
}

void fastMPUAdjMag(int16_t* mag) {
  mag[0] = ( (int32_t)mag[0] * ((int32_t)magSensAdj[1] + 128)  ) >> 8;
  mag[1] = ( (int32_t)mag[1] * ((int32_t)magSensAdj[0] + 128)  ) >> 8;
  mag[2] = ( (int32_t)mag[2] * ((int32_t)magSensAdj[2] + 128)  ) >> 8;
}
  
int fastMPUParseMag(uint8_t* magData, int16_t* mag) {

  int state = fastMPUParseRawMag(magData, mag);
  fastMPUAdjMag(mag);

  return state;
}

int fastMPUReadMag(int16_t* mag) {

  int state = fastMPUReadRawMag(mag);
  fastMPUAdjMag(mag);

  return state;
}
  
#endif
